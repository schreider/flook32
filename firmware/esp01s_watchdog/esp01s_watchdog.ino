/**
 * ███████╗██╗      ██████╗   ██████╗ ██╗  ██╗ ██████╗ ██████╗
 * ██╔════╝██║     ██╔═══██╗ ██╔══██╗ ██║ ██╔╝ ╚════██╗╚════██╗
 * █████╗  ██║     ██║   ██║ ██║  ██║ █████╔╝   █████╔╝ █████╔╝
 * ██╔══╝  ██║     ██║   ██║ ██║  ██║ ██╔═██╗   ╚═══██╗██╔═══╝ 
 * ██║     ███████╗╚██████╔╝ ██████╔╝ ██║  ██╗ ██████╔╝███████╗
 * ╚═╝     ╚══════╝ ╚═════╝  ╚═════╝  ╚═╝  ╚═╝ ╚═════╝ ╚══════╝
 *                 ██╗    ██╗ █████╗ ████████╗ ██████╗██╗  ██╗██████╗  ██████╗  ██████╗ 
 *                 ██║    ██║██╔══██╗╚══██╔══╝██╔════╝██║  ██║██╔══██╗██╔═══██╗██╔════╝ 
 *                 ██║ █╗ ██║███████║   ██║   ██║     ███████║██║  ██║██║   ██║██║  ███╗
 *                 ██║███╗██║██╔══██║   ██║   ██║     ██╔══██║██║  ██║██║   ██║██║   ██║
 *                 ╚███╔███╔╝██║  ██║   ██║   ╚██████╗██║  ██║██████╔╝╚██████╔╝╚██████╔╝
 *                  ╚══╝╚══╝ ╚═╝  ╚═╝   ╚═╝    ╚═════╝╚═╝  ╚═╝╚═════╝  ╚═════╝  ╚═════╝ 
 * 
 * =====================================================================================
 *                            ESP-01S WATCHDOG v1.0.0
 *              АППАРАТНЫЙ СТОРОЖЕВОЙ ТАЙМЕР ДЛЯ ЗАЩИТЫ НАГРЕВАТЕЛЯ
 * =====================================================================================
 * 
 * АВТОР:          t.me/schreid
 * ПЛАТФОРМА:      Espressif ESP8266 (ESP-01S), Tensilica L106 32-bit, 80 МГц
 * СРЕДА:          Arduino Core for ESP8266 3.x
 * 
 * НАЗНАЧЕНИЕ:
 *   Автономный аппаратный сторожевой таймер для аварийного отключения
 *   питания 220В нагревателя при зависании или выходе из строя основного
 *   контроллера FLOOK32 (ESP32). Работает на отдельном микроконтроллере
 *   и не зависит от состояния основной прошивки.
 * 
 * 
 * ┌─────────────────────────────────────────────────────────────────────────────────┐
 * │                            ЛИЦЕНЗИЯ GPLv3                                       │
 * └─────────────────────────────────────────────────────────────────────────────────┘
 * 
 * Copyright (C) 2026 t.me/schreid
 * 
 * This program is free software: you can redistribute it and/or modify
 * it under the terms of the GNU General Public License as published by
 * the Free Software Foundation, either version 3 of the License, or
 * (at your option) any later version.
 * 
 * This program is distributed in the hope that it will be useful,
 * but WITHOUT ANY WARRANTY; without even the implied warranty of
 * MERCHANTABILITY or FITNESS FOR A PARTICULAR PURPOSE.  See the
 * GNU General Public License for more details.
 * 
 * You should have received a copy of the GNU General Public License
 * along with this program.  If not, see <https://www.gnu.org/licenses/>.
 * 
 * 
 * ┌─────────────────────────────────────────────────────────────────────────────────┐
 * │                              ПРИНЦИП РАБОТЫ                                     │
 * └─────────────────────────────────────────────────────────────────────────────────┘
 * 
 * FLOOK32 генерирует периодические импульсы (heartbeat) на пине GPIO26.
 * Эти импульсы поступают на GPIO2 ESP-01S.
 * 
 * Если импульсы присутствуют — ESP32 работает штатно, реле замкнуто,
 * питание 220В подаётся на нагреватель.
 * 
 * Если импульсы пропали на 6 секунд — ESP32 завис или вышел из строя,
 * реле размыкается, нагреватель обесточивается.
 * 
 * Требуется 3 последовательных импульса для включения реле — защита
 * от случайных помех и кратковременных наводок на линию.
 * 
 * При старте реле всегда выключено — безопасное состояние.
 * 
 * 
 * ┌─────────────────────────────────────────────────────────────────────────────────┐
 * │                         СХЕМА ПОДКЛЮЧЕНИЯ                                       │
 * └─────────────────────────────────────────────────────────────────────────────────┘
 * 
 * FLOOK32 (ESP32)                    ESP-01S (ESP8266)                Нагрузка
 * ┌──────────────┐                  ┌──────────────┐              ┌──────────┐
 * │              │                  │              │              │          │
 * │  GPIO26 ─────┼──────────────────┼  GPIO2       │              │  220V    │
 * │  (heartbeat) │   импульс каждые │  (вход)      │     NO  ─────┼──────────┤
 * │              │   1000 мс        │              │   (реле)     │          │
 * │              │                  │              │              │ Нагрева- │
 * │              │                  │              │              │ тель     │
 * └──────────────┘                  └──────────────┘              └──────────┘
 * 
 * =====================================================================================
 * Версия:     1.0.0
 * Сборка:     {__DATE__} {__TIME__}
 * Changelog:
 *   • Первый релиз
 *   • Детектирование heartbeat по прерыванию (RISING)
 *   • Защита от ложных срабатываний (3 импульса для включения)
 *   • Автоотключение через 6 секунд после потери сигнала
 *   • Программный watchdog ESP8266 для самовосстановления
 */

// ============================================================================
// ПИНЫ ESP-01S
// ============================================================================
// На модуле ESP-01S доступно всего 4 пина:
//   GPIO0 — используется как выход управления реле
//   GPIO2 — используется как вход heartbeat от FLOOK32
//   TX/RX — не используются (зарезервированы для прошивки)

#define HEARTBEAT_PIN 2         // Вход heartbeat сигнала от FLOOK32 (GPIO26 ESP32 → GPIO2 ESP-01S)
#define RELAY_PIN 0             // Выход управления реле (LOW = выкл, HIGH = вкл)

// Уровни управления реле
// Реле нормально-разомкнутое (NO): HIGH замыкает цепь 220В, LOW размыкает
#define RELAY_ON HIGH           // Высокий уровень = реле замкнуто = 220В подано
#define RELAY_OFF LOW           // Низкий уровень = реле разомкнуто = 220В отключено

// ============================================================================
// ТАЙМИНГИ (ОПРЕДЕЛЯЮТ ЧУВСТВИТЕЛЬНОСТЬ И БЕЗОПАСНОСТЬ)
// ============================================================================

// Время без сигнала heartbeat, после которого реле отключается (миллисекунды)
// Расчёт: FLOOK32 отправляет импульс каждые ~1000 мс (100 мс HIGH + 900 мс LOW) 
// 6 секунд = 6 пропущенных импульсов — гарантированное обнаружение зависания
const unsigned long SIGNAL_LOSS_TIMEOUT_MS = 6000;

// Максимальный интервал между соседними импульсами для продолжения серии (миллисекунды)
// Если прошло больше — считаем что серия прервалась и начинаем подсчёт заново
// 5 секунд = 5 полных периодов heartbeat с запасом на джиттер
const unsigned long PULSE_TIMEOUT_MS = 5000;

// ============================================================================
// ГЛОБАЛЬНЫЕ ПЕРЕМЕННЫЕ
// ============================================================================

// Флаг срабатывания прерывания (volatile — изменяется в ISR)
// Устанавливается в onPulse() при каждом фронте LOW→HIGH на пине heartbeat
volatile bool pulseFlag = false;

// Время последнего зафиксированного импульса (миллисекунды)
// Используется для расчёта интервалов и детектирования потери сигнала
unsigned long lastPulseTime = 0;

// Счётчик последовательных импульсов в текущей серии
// Сбрасывается в 0, если интервал между импульсами превысил PULSE_TIMEOUT_MS
// или если сигнал отсутствовал дольше SIGNAL_LOSS_TIMEOUT_MS
int consecutivePulses = 0;

// Текущее состояние реле (true = замкнуто = 220В подано)
// Используется для предотвращения повторных переключений реле
bool relayState = false;

// ============================================================================
// ОБРАБОТЧИК ПРЕРЫВАНИЯ (ISR — INTERRUPT SERVICE ROUTINE)
// ============================================================================

/**
 * Обработчик аппаратного прерывания по фронту RISING на пине HEARTBEAT_PIN.
 * 
 * ВАЖНО: ICACHE_RAM_ATTR размещает функцию в IRAM (оперативной памяти),
 * а не во flash. Это необходимо, потому что во время срабатывания прерывания
 * flash-память может быть занята другой операцией (запись/чтение), и обращение
 * к ней из ISR приведёт к сбою (крэш/перезагрузка ESP8266).
 * 
 * ISR выполняет минимальную работу: только устанавливает флаг pulseFlag.
 * Основная логика обработки вынесена в loop() для избежания длительных
 * операций в контексте прерывания.
 * 
 * Вызывается: автоматически при каждом фронте LOW→HIGH на HEARTBEAT_PIN
 */
ICACHE_RAM_ATTR void onPulse()
{
    pulseFlag = true;   // Устанавливаем флаг — loop() обработает его в основном цикле
}

// ============================================================================
// УПРАВЛЕНИЕ РЕЛЕ (БЕЗОПАСНОСТЬ ПИТАНИЯ 220В)
// ============================================================================

/**
 * Устанавливает состояние реле и запоминает его.
 * 
 * Параметры:
 *   - on: true = замкнуть реле (подать 220В), false = разомкнуть (отключить 220В)
 * 
 * Сохраняет состояние в relayState для предотвращения излишних переключений
 * (продлевает ресурс реле, исключает дребезг).
 * 
 * Вызывается: loop() при изменении условий (потеря/восстановление heartbeat)
 */
void setRelay(bool on)
{
    digitalWrite(RELAY_PIN, on ? RELAY_ON : RELAY_OFF);
    relayState = on;
}

// ============================================================================
// ИНИЦИАЛИЗАЦИЯ (ВЫПОЛНЯЕТСЯ ОДИН РАЗ ПРИ СТАРТЕ)
// ============================================================================

void setup()
{
    // ----- 1. НАСТРОЙКА ПИНА РЕЛЕ -----
    // Реле при старте ВСЕГДА выключено — безопасное состояние.
    // Даже если ESP-01S перезагрузился из-за собственного watchdog,
    // нагреватель не включится самопроизвольно.
    pinMode(RELAY_PIN, OUTPUT);
    digitalWrite(RELAY_PIN, RELAY_OFF);
    delay(200);                      // Задержка для стабилизации уровня на пине

    // ----- 2. НАСТРОЙКА ПИНА HEARTBEAT -----
    // Пин работает как вход без подтяжки — уровень определяется
    // исключительно сигналом от FLOOK32.
    pinMode(HEARTBEAT_PIN, INPUT);

    // ----- 3. ИНИЦИАЛИЗАЦИЯ ТАЙМЕРА -----
    // Устанавливаем время последнего импульса в текущее,
    // чтобы сразу после старта не сработал таймаут потери сигнала
    // (даём FLOOK32 время на отправку первого импульса).
    lastPulseTime = millis();

    // ----- 4. ПОДКЛЮЧЕНИЕ ПРЕРЫВАНИЯ -----
    // Прерывание по фронту RISING (LOW → HIGH) на пине HEARTBEAT_PIN.
    // Каждый импульс heartbeat от FLOOK32 (GPIO26) вызывает onPulse().
    // Используем digitalPinToInterrupt для совместимости с Arduino API.
    attachInterrupt(digitalPinToInterrupt(HEARTBEAT_PIN), onPulse, RISING);
}

// ============================================================================
// ОСНОВНОЙ ЦИКЛ (ВЫПОЛНЯЕТСЯ БЕСКОНЕЧНО)
// ============================================================================

void loop()
{
    // ----- 1. СБРОС ПРОГРАММНОГО WATCHDOG ESP8266 -----
    // ESP8266 имеет встроенный программный watchdog с таймаутом ~3.2 секунды.
    // Если не сбрасывать его — ESP-01S перезагрузится.
    // Это защита от зависания самого ESP-01S.
    ESP.wdtFeed();

    // Текущее время в миллисекундах с момента старта
    unsigned long now = millis();

    // ----- 2. ОБРАБОТКА ФЛАГА ПРЕРЫВАНИЯ -----
    // Если с момента прошлой проверки произошёл импульс heartbeat
    if (pulseFlag) {
        pulseFlag = false;   // Сбрасываем флаг для детектирования следующего импульса

        // Проверяем интервал с предыдущим импульсом:
        // - если меньше PULSE_TIMEOUT_MS (5 сек) — продолжаем серию
        // - если больше — начинаем новую серию (первый импульс)
        if (now - lastPulseTime < PULSE_TIMEOUT_MS) {
            consecutivePulses++;     // Импульс в пределах таймаута — увеличиваем счётчик
        } else {
            consecutivePulses = 1;   // Слишком большой интервал — начинаем новую серию
        }

        // Обновляем время последнего импульса для следующей проверки
        lastPulseTime = now;
    }

    // ----- 3. ПРОВЕРКА ПОТЕРИ СИГНАЛА -----
    // Если с последнего импульса прошло больше SIGNAL_LOSS_TIMEOUT_MS (6 сек),
    // считаем что FLOOK32 завис или выключен — сбрасываем счётчик импульсов.
    if (now - lastPulseTime > SIGNAL_LOSS_TIMEOUT_MS) {
        consecutivePulses = 0;
    }

    // ----- 4. ПРИНЯТИЕ РЕШЕНИЯ О РЕЛЕ -----
    // Реле включается только если накоплено 3 и более последовательных импульса.
    // Это защита от:
    //   - Случайных помех и наводок на линию
    //   - Кратковременных всплесков при включении/выключении FLOOK32
    //   - Дребезга контактов
    bool shouldRelayOn = (consecutivePulses >= 3);

    // ----- 5. ПЕРЕКЛЮЧЕНИЕ РЕЛЕ ПРИ ИЗМЕНЕНИИ СОСТОЯНИЯ -----
    // setRelay() проверяет, изменилось ли состояние, и переключает реле
    // только если нужно. Это предотвращает лишние циклы переключения
    // и продлевает ресурс электромеханического реле.
    if (shouldRelayOn != relayState) {
        setRelay(shouldRelayOn);
    }

    // ----- 6. ЗАДЕРЖКА ДЛЯ СТАБИЛЬНОСТИ -----
    // Минимальная задержка 20 мс:
    //   - Достаточно для обнаружения импульсов heartbeat (период ~1000 мс)
    //   - Не нагружает процессор (50 итераций в секунду)
    //   - Позволяет ESP8266 обрабатывать WiFi при необходимости
    delay(20);
}
